## conf/distro/rubus.conf
```bitbake
# based on poky standard
require conf/distro/poky.conf

DISTRO = "rubus"
DISTRO_NAME = "Rubus GNU/Linux"
DISTRO_VERSION = "1.0-${DATE}"

MAINTAINER = "Patrik Obrist <padx@gmx.net>"

# override raspberry pi default
PREFERRED_VERSION_udev = "182"

PREFERRED_PROVIDER_jpeg = "libjpeg-turbo"
PREFERRED_PROVIDER_jpeg-native = "libjpeg-turbo-native"
```
